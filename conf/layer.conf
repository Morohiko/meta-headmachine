## conf/layer.conf
```bitbake
# We have a conf and classes directory, add to BBPATH
BBPATH .= ":${LAYERDIR}"

# We have recipes-* directories, add to BBFILES
BBFILES += "${LAYERDIR}/recipes-*/*/*.bb \
            ${LAYERDIR}/recipes-*/*/*.bbappend"

BBFILE_COLLECTIONS += "meta-headmachine"
BBFILE_PATTERN_meta-headmachine = "^${LAYERDIR}/"
BBFILE_PRIORITY_meta-headmachine = "3"

LAYERDEPENDS_meta-headmachine = "core"
LAYERSERIES_COMPAT_meta-headmachine = "dunfell"

PACKAGE_CLASSES ?= "package_deb"
```
